/**
 * @cliArgs --board "/ti/boards/CC3220S_LAUNCHXL" --rtos "tirtos" --product "simplelink_cc32xx_sdk@6.10.00.05"
 * @versions {"tool":"1.12.0+2406"}
 */

/**
 * Import the modules used in this configuration.
 */
const Display  = scripting.addModule("/ti/display/Display");
const Display1 = Display.addInstance();
const GPIO     = scripting.addModule("/ti/drivers/GPIO");
const GPIO1    = GPIO.addInstance();
const GPIO2    = GPIO.addInstance();
const GPIO3    = GPIO.addInstance();
const GPIO4    = GPIO.addInstance();
const SPI      = scripting.addModule("/ti/drivers/SPI");
const SPI1     = SPI.addInstance();

/**
 * Write custom configuration values to the imported modules.
 */
Display1.$name      = "CONFIG_Display_0";
Display1.$hardware  = system.deviceData.board.components.XDS110UART;
Display1.uart.$name = "CONFIG_UART2_0";

GPIO1.$hardware = system.deviceData.board.components.LED_RED;
GPIO1.$name     = "CONFIG_GPIO_LED_0";

GPIO2.$hardware = system.deviceData.board.components.LED_GREEN;
GPIO2.$name     = "CONFIG_GPIO_LED_1";

GPIO3.$name           = "CONFIG_SPI_MASTER_READY";
GPIO3.gpioPin.$assign = "boosterpack.19";

GPIO4.$name           = "CONFIG_SPI_SLAVE_READY";
GPIO4.gpioPin.$assign = "boosterpack.4";

const Power          = scripting.addModule("/ti/drivers/Power", {}, false);
Power.parkPins.$name = "ti_drivers_power_PowerCC32XXPins0";

SPI1.$name                    = "CONFIG_SPI_SLAVE";
SPI1.mode                     = "Four Pin SS Active Low";
SPI1.spi.sclkPin.$assign      = "boosterpack.17";
SPI1.spi.misoPin.$assign      = "boosterpack.28";
SPI1.spi.mosiPin.$assign      = "boosterpack.15";
SPI1.spi.dmaRxChannel.$assign = "UDMA_CH30";
SPI1.spi.dmaTxChannel.$assign = "UDMA_CH31";
SPI1.spi.ssPin.$assign        = "boosterpack.30";

/**
 * Pinmux solution for unlocked pins/peripherals. This ensures that minor changes to the automatic solver in a future
 * version of the tool will not impact the pinmux you originally saw.  These lines can be completely deleted in order to
 * re-solve from scratch.
 */
Display1.uart.uart.$suggestSolution              = "UART1";
Display1.uart.uart.txPin.$suggestSolution        = "ball.55";
Display1.uart.uart.txDmaChannel.$suggestSolution = "UDMA_CH11";
Display1.uart.uart.rxPin.$suggestSolution        = "ball.57";
Display1.uart.uart.rxDmaChannel.$suggestSolution = "UDMA_CH10";
GPIO1.gpioPin.$suggestSolution                   = "boosterpack.29";
GPIO2.gpioPin.$suggestSolution                   = "boosterpack.10";
SPI1.spi.$suggestSolution                        = "SPI0";
