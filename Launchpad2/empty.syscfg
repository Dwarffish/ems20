/**
 * @cliArgs --board "/ti/boards/CC3220S_LAUNCHXL" --product "simplelink_cc32xx_sdk@5.20.00.06"
 * @versions {"data":"2021031521","timestamp":"2021031521","tool":"1.8.0+1863","templates":null}
 */

/**
 * Import the modules used in this configuration.
 */
const GPIO  = scripting.addModule("/ti/drivers/GPIO");
const GPIO1 = GPIO.addInstance();
const GPIO2 = GPIO.addInstance();
const GPIO3 = GPIO.addInstance();
const GPIO4 = GPIO.addInstance();
const GPIO5 = GPIO.addInstance();
const RTOS  = scripting.addModule("/ti/drivers/RTOS");

/**
 * Write custom configuration values to the imported modules.
 */
GPIO1.$hardware = system.deviceData.board.components.LED_RED;
GPIO1.$name     = "CONFIG_GPIO_LED_0";

GPIO2.$name     = "CONFIG_GPIO_LED_1";
GPIO2.$hardware = system.deviceData.board.components.LED_YELLOW;

GPIO3.$name     = "CONFIG_GPIO_LED_2";
GPIO3.$hardware = system.deviceData.board.components.LED_GREEN;

GPIO4.$name     = "CONFIG_GPIO_SW_0";
GPIO4.$hardware = system.deviceData.board.components.SW2;
GPIO4.pull      = "Pull Down";

GPIO5.$name     = "CONFIG_GPIO_SW_1";
GPIO5.$hardware = system.deviceData.board.components.SW3;
GPIO5.pull      = "Pull Down";

const Power          = scripting.addModule("/ti/drivers/Power", {}, false);
Power.parkPins.$name = "ti_drivers_power_PowerCC32XXPins0";

/**
 * Pinmux solution for unlocked pins/peripherals. This ensures that minor changes to the automatic solver in a future
 * version of the tool will not impact the pinmux you originally saw.  These lines can be completely deleted in order to
 * re-solve from scratch.
 */
GPIO1.gpioPin.$suggestSolution = "boosterpack.29";
GPIO2.gpioPin.$suggestSolution = "boosterpack.9";
GPIO3.gpioPin.$suggestSolution = "boosterpack.10";
GPIO4.gpioPin.$suggestSolution = "boosterpack.3";
GPIO5.gpioPin.$suggestSolution = "boosterpack.11";
